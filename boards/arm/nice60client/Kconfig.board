## boards/arm/nice60client/Kconfig.board
```kconfig
# Copyright (c) 2021 Nick Winans
# SPDX-License-Identifier: MIT

config BOARD_NICE60CLIENT
    bool "nice!60!client"
    depends on SOC_NRF52840_QIAA
```

## boards/arm/nice60client/Kconfig.defconfig
```kconfig
# Copyright (c) 2021 Nick Winans
# SPDX-License-Identifier: MIT

if BOARD_NICE60CLIENT

config BOARD_NICE60SERVER
    bool "central mode"
    default y

if BOARD_NICE60SERVER

config ZMK_KEYBOARD_NAME
    default "nice-60-server"

config ZMK_SPLIT_ROLE_CENTRAL
    default y

endif

if USB_DEVICE_STACK

config USB_NRFX
    default y

endif # USB_DEVICE_STACK

config BT_CTLR
    default BT

config ZMK_SPLIT
    default y

endif # BOARD_NICE60CLIENT
```

## boards/shields/nice_nano_60/Kconfig.shield
```kconfig
# Copyright (c) 2020 Pete Johanson
# SPDX-License-Identifier: MIT

config SHIELD_NICE_DONGLE
    def_bool $(shields_list_contains,lily58_left)

config SHIELD_NICE_BOARD
    def_bool $(shields_list_contains,lily58_right)
```
